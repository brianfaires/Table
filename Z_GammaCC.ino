const uint8_t PROGMEM gammaR[] = { // 1.9, replaced 1's with 2's
  0,2,2,2,2,2,2,2,2,2,2,2,2,2,2,2,
  2,2,2,2,2,2,2,3,3,3,3,4,4,4,4,5,
  5,5,6,6,6,7,7,7,8,8,8,9,9,9,10,10,
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  227,229,231,233,235,236,238,240,242,244,246,247,249,251,253,255 };

const uint8_t PROGMEM reverseGammaR[] = { // 1.9
  0,9,20,24,28,32,35,38,41,44,46,48,51,53,55,57,
  59,61,63,65,66,68,70,72,73,75,76,78,79,81,82,84,
  85,87,88,89,91,92,93,95,96,97,99,100,101,102,103,105,
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  247,247,248,248,249,249,250,251,251,252,252,253,253,254,255,255 };

const uint8_t PROGMEM gammaG[] = { // 1.9; replaced 1's with 0's
  0,2,2,2,2,2,2,2,2,2,2,2,2,2,2,2,
  2,2,2,2,2,2,2,3,3,3,3,4,4,4,4,5,
  5,5,6,6,6,7,7,7,8,8,8,9,9,9,10,10,
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  227,229,231,233,235,236,238,240,242,244,246,247,249,251,253,255 };

const uint8_t PROGMEM reverseGammaG[] = { // 1.9
  0,9,20,24,28,32,35,38,41,44,46,48,51,53,55,57,
  59,61,63,65,66,68,70,72,73,75,76,78,79,81,82,84,
  85,87,88,89,91,92,93,95,96,97,99,100,101,102,103,105,
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  247,247,248,248,249,249,250,251,251,252,252,253,253,254,255,255 };

const uint8_t PROGMEM gammaB[] = { // 1.8
  0,1,1,1,1,1,1,1,1,1,1,1,1,1,1,2,
  2,2,2,2,3,3,3,3,4,4,4,4,5,5,5,6,
  6,6,7,7,8,8,8,9,9,10,10,10,11,11,12,12,
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  229,230,232,234,236,237,239,241,243,244,246,248,250,251,253,255 };

const uint8_t PROGMEM reverseGammaB[] = { // 1.8
  0,7,17,21,25,29,32,34,37,39,42,44,46,48,50,52,
  54,56,58,60,62,63,65,67,68,70,71,73,74,76,77,79,
  80,82,83,84,86,87,88,90,91,92,94,95,96,97,98,100,
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  246,247,247,248,249,249,250,250,251,251,252,253,253,254,255,255 };
  
inline void GammaCorrect(CRGB& pixel) {
  pixel.r = pgm_read_byte(&gammaR[pixel.r]);
  pixel.g = pgm_read_byte(&gammaG[pixel.g]);
  pixel.b = pgm_read_byte(&gammaB[pixel.b]);
}

inline void ReverseGammaCorrect(CRGB& pixel) {
  pixel.r = pgm_read_byte(&reverseGammaR[pixel.r]);
  pixel.g = pgm_read_byte(&reverseGammaG[pixel.g]);
  pixel.b = pgm_read_byte(&reverseGammaB[pixel.b]);
}


// ------------ Tests ------------
void RunSimpleColorCorrectionTest() {
  static uint8_t b = 64;
  for(int i=0; i < NUM_LEDS && i < 80; i+=25) {
    leds(i,i+3) = CRGB(b,0,0);
    leds(i+5,i+8) = CRGB(0,b,0);
    leds(i+10,i+13) = CRGB(0,0,b);
    leds(i+20,i+23) = CRGB(b,b,b);
  }
  FastLED.show();
  
  Serial.println("Enter brightness value (1-255)");
  while(Serial.available() == 0) ;
  String s = Serial.readString();
  s.trim();
  b = s.toInt();
}

void RunGradientColorCorrectionTest() {
  const uint8_t ss = 50; // step size between gradients
  static uint8_t b = 64;
  static uint32_t colCorrection = COLOR_CORRECTION;
  static float gammaR = 1.9;//1.60;//1.75;//1.8;//1.65;//1.15;
  static float gammaG = 1.9;//1.75;//1.90;//1.6;//2.1;//1.65;
  static float gammaB = 1.8;//1.80;//2.00;//3.1;//3.1;//2.85;

  fill_gradient(&leds[383-3*ss], 3*ss, CHSV(255,255,b), CHSV(0,255,b), LONGEST_HUES);
  fill_gradient(&leds[383-6*ss], 3*ss, CHSV(255,255,b), CHSV(0,255,b), LONGEST_HUES);
  
  fill_gradient_RGB(leds,   0, CRGB(255,0,0),  ss, CRGB(0,255,0));
  fill_gradient_RGB(leds,  ss, CRGB(0,255,0),2*ss, CRGB(0,0,255));
  fill_gradient_RGB(leds,2*ss, CRGB(0,0,255),3*ss, CRGB(255,0,0));
  fill_gradient_RGB(leds,3*ss, CRGB(255,0,0),4*ss, CRGB(0,255,0));
  fill_gradient_RGB(leds,4*ss, CRGB(0,255,0),5*ss, CRGB(0,0,255));
  fill_gradient_RGB(leds,5*ss, CRGB(0,0,255),6*ss, CRGB(255,0,0));

  for(int i = 0; i <= 6*ss; i++) {
    leds[i].r = applyGamma_video(leds[i].r, gammaR);
    leds[i].g = applyGamma_video(leds[i].g, gammaG);
    leds[i].b = applyGamma_video(leds[i].b, gammaB);
  }

  leds %= b;

  FastLED.setCorrection(colCorrection);
  FastLED.show();


  Serial.println("brightness: " + String(b) + "\tColorCorrection: " + String(colCorrection, HEX) + "\r\nGammas: " + String(gammaR) + "\t" + String(gammaG) + "\t" + String(gammaB));
  Serial.println("Enter 'r' 'g' 'b' to edit gamma. 'c' to edit color correction. Or enter a number to edit brightness (1-255).");
  while(Serial.available() == 0) ;
  String s = Serial.readString();
  s.trim();
  
  if(s == "r") {
    Serial.println("Enter new red gamma value. (Current is " + String(gammaR) + ")");
    while(Serial.available() == 0) ;
    s = Serial.readString();
    s.trim();
    gammaR = s.toFloat();
  }
  else if(s == "g") {
    Serial.println("Enter new green gamma value. (Current is " + String(gammaG) + ")");
    while(Serial.available() == 0) ;
    s = Serial.readString();
    s.trim();
    gammaG = s.toFloat();    
  }
  else if(s == "b") {
    Serial.println("Enter new blue gamma value. (Current is " + String(gammaB) + ")");
    while(Serial.available() == 0) ;
    s = Serial.readString();
    s.trim();
    gammaB = s.toFloat();
  }
  else if(s == "c") {
    Serial.println("Enter new color correction as a 6-digit hex number");
    while(Serial.available() == 0) ;
    s = Serial.readString();
    s.trim();
    s.toUpperCase();

    colCorrection = 0;
    for(int i=0; s[i]; i++){
      if(s[i] >= '0' && s[i] <= '9') {
          colCorrection *= 0x10;
          colCorrection += s[i] - '0';
      }
      else {
          colCorrection *= 0x10;
          colCorrection += s[i] - 'A' + 10;
      }
    }
  }
  else {
    b = s.toInt();
  }
}

